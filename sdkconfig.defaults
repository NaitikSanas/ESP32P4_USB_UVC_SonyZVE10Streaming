## sdkconfig.defaults
```kconfig
CONFIG_SPIRAM=y
CONFIG_UVC_INTERVAL_ARRAY_SIZE=16
CONFIG_SPIRAM_SPEED_200M=y
CONFIG_SPIRAM_SPEED=200
CONFIG_ESP_DEFAULT_CPU_FREQ_MHZ_360=y
CONFIG_ESP_DEFAULT_CPU_FREQ_MHZ=360
CONFIG_FREERTOS_HZ=1000
```
